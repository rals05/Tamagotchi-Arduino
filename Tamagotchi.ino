#include <Wire.h>
#include <Adafruit_GFX.h>
#include <Adafruit_SSD1306.h>

#define SCREEN_WIDTH 128
#define SCREEN_HEIGHT 64
#define OLED_RESET -1

Adafruit_SSD1306 display(SCREEN_WIDTH, SCREEN_HEIGHT, &Wire, OLED_RESET);

const unsigned char bitmap_happy [] PROGMEM = {
	0x00, 0x00, 0x00, 0x00, 0x00, 0x00, 0x00, 0x00, 0x00, 0x00, 0x00, 0x00, 0x00, 0x00, 0x00, 0x00, 
	0x00, 0x00, 0x00, 0x00, 0x00, 0x00, 0x00, 0x00, 0x00, 0x00, 0x00, 0x00, 0x00, 0x00, 0x00, 0x00, 
	0x00, 0x0c, 0x18, 0x00, 0x00, 0x1e, 0x3c, 0x00, 0x00, 0x1e, 0x3c, 0x00, 0x00, 0x0f, 0x78, 0x00, 
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	0x00, 0x00, 0x00, 0x00, 0x00, 0x00, 0x00, 0x00, 0x00, 0x00, 0x00, 0x00, 0x00, 0x00, 0x00, 0x00
};

const unsigned char bitmap_sleeping [] PROGMEM = {
	0x00, 0x00, 0x00, 0x00, 0x00, 0x00, 0x00, 0x00, 0x00, 0x00, 0x00, 0x00, 0x00, 0x00, 0x00, 0x00, 
	0x00, 0x00, 0x00, 0x00, 0x00, 0x00, 0x00, 0x00, 0x00, 0x00, 0x01, 0xe0, 0x00, 0x00, 0x00, 0x20, 
	0x00, 0x0c, 0x18, 0x40, 0x00, 0x1e, 0x3c, 0x80, 0x00, 0x1e, 0x3d, 0xe0, 0x00, 0x0f, 0x78, 0x00, 
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	0x00, 0x00, 0x00, 0x00, 0x00, 0x00, 0x00, 0x00, 0x00, 0x00, 0x00, 0x00, 0x00, 0x00, 0x00, 0x00
};

const unsigned char bitmap_playing [] PROGMEM = {
	0x00, 0x00, 0x00, 0x00, 0x00, 0x00, 0x00, 0x00, 0x00, 0x00, 0x00, 0x00, 0x00, 0x00, 0x00, 0x00, 
	0x00, 0x00, 0x00, 0x00, 0x03, 0x80, 0x00, 0x00, 0x04, 0x40, 0x00, 0x00, 0x04, 0x40, 0x00, 0x00, 
	0x04, 0x4c, 0x18, 0x00, 0x04, 0x5e, 0x3c, 0x00, 0x03, 0x9e, 0x3c, 0x00, 0x01, 0x0f, 0x78, 0x00, 
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	0x00, 0x00, 0x00, 0x00, 0x00, 0x00, 0x00, 0x00, 0x00, 0x00, 0x00, 0x00, 0x00, 0x00, 0x00, 0x00
};

const unsigned char bitmap_sad [] PROGMEM = {
	0x00, 0x00, 0x00, 0x00, 0x00, 0x00, 0x00, 0x00, 0x00, 0x00, 0x00, 0x00, 0x00, 0x00, 0x00, 0x00, 
	0x00, 0x00, 0x00, 0x00, 0x00, 0x00, 0x00, 0x00, 0x00, 0x00, 0x00, 0x00, 0x00, 0x00, 0x00, 0x00, 
	0x00, 0x0c, 0x18, 0x00, 0x00, 0x1e, 0x3c, 0x00, 0x00, 0x1e, 0x3c, 0x00, 0x00, 0x0f, 0x78, 0x00, 
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	0x00, 0x00, 0x00, 0x00, 0x00, 0x00, 0x00, 0x00, 0x00, 0x00, 0x00, 0x00, 0x00, 0x00, 0x00, 0x00
};

const unsigned char bitmap_tired [] PROGMEM = {
	0x00, 0x00, 0x00, 0x00, 0x00, 0x00, 0x00, 0x00, 0x00, 0x00, 0x00, 0x00, 0x00, 0x00, 0x00, 0x00, 
	0x00, 0x00, 0x00, 0x00, 0x00, 0x00, 0x00, 0x00, 0x00, 0x00, 0x00, 0x00, 0x00, 0x00, 0x00, 0x00, 
	0x00, 0x0c, 0x18, 0x00, 0x00, 0x1e, 0x3c, 0x00, 0x00, 0x1e, 0x3c, 0x00, 0x00, 0x0f, 0x78, 0x00, 
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	0x00, 0x00, 0x00, 0x00, 0x00, 0x00, 0x00, 0x00, 0x00, 0x00, 0x00, 0x00, 0x00, 0x00, 0x00, 0x00
};

const unsigned char bitmap_hungry [] PROGMEM = {
	0x00, 0x00, 0x00, 0x00, 0x00, 0x00, 0x00, 0x00, 0x00, 0x00, 0x00, 0x00, 0x00, 0x00, 0x00, 0x00, 
	0x00, 0x00, 0x00, 0x00, 0x00, 0x00, 0x00, 0x00, 0x00, 0x00, 0x00, 0x00, 0x00, 0x00, 0x00, 0x00, 
	0x00, 0x0c, 0x18, 0x00, 0x00, 0x1e, 0x3c, 0x00, 0x00, 0x1e, 0x3c, 0x00, 0x00, 0x0f, 0x78, 0x00, 
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	0x00, 0x00, 0x00, 0x00, 0x00, 0x00, 0x00, 0x00, 0x00, 0x00, 0x00, 0x00, 0x00, 0x00, 0x00, 0x00
};

const unsigned char bitmap_eating [] PROGMEM = {
	0x00, 0x00, 0x00, 0x00, 0x00, 0x00, 0x00, 0x00, 0x00, 0x00, 0x00, 0x00, 0x00, 0x00, 0x00, 0x00, 
	0x00, 0x00, 0x00, 0x00, 0x00, 0x00, 0x00, 0x00, 0x00, 0x00, 0x00, 0x00, 0x00, 0x00, 0x00, 0x00, 
	0x00, 0x0c, 0x18, 0x00, 0x00, 0x1e, 0x3c, 0x00, 0x00, 0x1e, 0x3c, 0x00, 0x00, 0x0f, 0x78, 0x00, 
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	0x00, 0x00, 0x00, 0x00, 0x00, 0x00, 0x00, 0x00, 0x00, 0x00, 0x00, 0x00, 0x00, 0x00, 0x00, 0x00
};

const int feedButtonPin = 2;
const int sleepButtonPin = 3;
const int playButtonPin = 4;
const int buzzerPin = 5;

bool lastFeedButtonState = HIGH;
bool lastSleepButtonState = HIGH;
bool lastPlayButtonState = HIGH;

int currentHunger = 100;
int currentEnergy = 100;
int currentHappiness = 100;
bool isSleeping = false;

unsigned long lastHungerDecreaseTime = 0;
unsigned long lastEnergyRegenTime = 0;
unsigned long lastEnergyDecreaseTime = 0;
unsigned long lastHappinessDecreaseTime = 0;

unsigned long lastFeedPressTime = 0;
unsigned long lastSleepPressTime = 0;
unsigned long lastPlayPressTime = 0;
const unsigned long debounceDelay = 50;

bool showPlaying = false;
bool showEating = false;
unsigned long excitedStartTime = 0;
const unsigned long excitedDuration = 2000;

void drawBitmapScaled(int16_t x, int16_t y, const uint8_t *bitmap, int16_t w, int16_t h, uint8_t scale, uint16_t color) {
  int16_t bytesPerRow = (w + 7) / 8;
  for (int16_t row = 0; row < h; row++) {
    for (int16_t col = 0; col < w; col++) {
      uint8_t byte = pgm_read_byte(bitmap + row * bytesPerRow + col / 8);
      if (byte & (0x80 >> (col % 8))) {
        display.fillRect(x + col * scale, y + row * scale, scale, scale, color);
      }
    }
  }
}

void updateDisplay() {
  display.clearDisplay();

  const unsigned char* faceToShow;

  if (isSleeping) {
    faceToShow = bitmap_sleeping;
  } else if (showEating && millis() - excitedStartTime < excitedDuration) {
    faceToShow = bitmap_eating;
  } else if (showPlaying && millis() - excitedStartTime < excitedDuration) {
    faceToShow = bitmap_playing;
  } else if (currentHunger < 20) {
    faceToShow = bitmap_hungry;
  } else if (currentEnergy < 15) {
    faceToShow = bitmap_tired;
  } else if (currentHappiness < 10) {
    faceToShow = bitmap_sad;
  } else {
    faceToShow = bitmap_happy;
  }

  display.setTextSize(1);
  display.setTextColor(SSD1306_WHITE);
  display.setCursor(2, 4);
  display.print("Hunger:");
  display.println(currentHunger);
  display.setCursor(2, 24);
  display.print("Energy:");
  display.println(currentEnergy);
  display.setCursor(2, 44);
  display.print("Happy:");
  display.println(currentHappiness);

  drawBitmapScaled(64, 0, faceToShow, 32, 32, 2, SSD1306_WHITE);

  display.display();
}

void setup() {
  Serial.begin(9600);
  pinMode(feedButtonPin, INPUT_PULLUP);
  pinMode(sleepButtonPin, INPUT_PULLUP);
  pinMode(playButtonPin, INPUT_PULLUP);
  pinMode(buzzerPin, OUTPUT);

  display.begin(SSD1306_SWITCHCAPVCC, 0x3C);
  display.clearDisplay();
  updateDisplay();
}

void loop() {
  // ---- FEED BUTTON ----
  bool currentFeedState = digitalRead(feedButtonPin);
  if (lastFeedButtonState == HIGH && currentFeedState == LOW && millis() - lastFeedPressTime > debounceDelay) {
    lastFeedPressTime = millis();
    if (currentHunger != 100) {
      float increase = (100 - currentHunger) * 0.3;
      currentHunger = currentHunger + round(increase);
      if (currentHunger > 100) currentHunger = 100;

      currentEnergy = currentEnergy + 5;
      if (currentEnergy > 100) {
        currentEnergy = 100;
      }

      showPlaying = false;
      showEating = true;
      excitedStartTime = millis();

      digitalWrite(buzzerPin, HIGH);
      delay(50);
      digitalWrite(buzzerPin, LOW);
    }
    updateDisplay();
  }
  lastFeedButtonState = currentFeedState;

  // ---- SLEEP BUTTON ----
  bool currentSleepState = digitalRead(sleepButtonPin);
  if (lastSleepButtonState == HIGH && currentSleepState == LOW && millis() - lastSleepPressTime > debounceDelay) {
    lastSleepPressTime = millis();
    isSleeping = !isSleeping;

    digitalWrite(buzzerPin, HIGH);
    delay(50);
    digitalWrite(buzzerPin, LOW);

    updateDisplay();
  }
  lastSleepButtonState = currentSleepState;

  // ---- PLAY BUTTON ----
  bool currentPlayState = digitalRead(playButtonPin);
  if (lastPlayButtonState == HIGH && currentPlayState == LOW && millis() - lastPlayPressTime > debounceDelay) {
    lastPlayPressTime = millis();
    if (currentHappiness != 100) {
      currentHappiness = currentHappiness + 10;
      if (currentHappiness > 100) {
        currentHappiness = 100;
      }
      currentEnergy = currentEnergy - 8;
      if (currentEnergy < 0) {
        currentEnergy = 0;
      }

      showEating = false;
      showPlaying = true;
      excitedStartTime = millis();

      digitalWrite(buzzerPin, HIGH);
      delay(50);
      digitalWrite(buzzerPin, LOW);
    }
    updateDisplay();
  }
  lastPlayButtonState = currentPlayState;

  // ---- HUNGER DECAY ----
  if (millis() - lastHungerDecreaseTime >= 3000) {
    if (currentHunger > 0) {
      currentHunger--;
    }
    lastHungerDecreaseTime = millis();
    updateDisplay();
  }

  // ---- ENERGY DECAY ----
  if (!isSleeping) {
    if (millis() - lastEnergyDecreaseTime >= 3500) {
      if (currentEnergy > 0) {
        currentEnergy--;
      }
      lastEnergyDecreaseTime = millis();
      updateDisplay();
    }
  }

  // ---- ENERGY WHILE SLEEPING ----
  if (isSleeping) {
    if (millis() - lastEnergyRegenTime >= 5000) {
      if (currentEnergy < 100) {
        currentEnergy++;
      }
      lastEnergyRegenTime = millis();
      updateDisplay();
    }
  }

  // ---- HAPPINESS DECAY ----
  if (millis() - lastHappinessDecreaseTime >= 4000) {
    if (currentHappiness > 0) {
      currentHappiness--;
    }
    lastHappinessDecreaseTime = millis();
    updateDisplay();
  }
}